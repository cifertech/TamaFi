#include "hatch_egg.h"

#include <math.h>
#include <pgmspace.h>

static const int kW = 158;
static const int kH = 192;
static const int kX = 41;
static const int kY = 24;
static const int kBy = 20;

static const uint8_t kClosed[3840] PROGMEM = {
  0x00, 0x00, 0x00, 0x00, 0x00, 0x00, 0x00, 0x03, 0xFF, 0xFF, 0xFF, 0xFF, 0x00, 0x00, 0x00, 0x00, 0x00, 0x00, 0x00, 0x00,
  0x00, 0x00, 0x00, 0x00, 0x00, 0x00, 0x00, 0x03, 0xFF, 0xFF, 0xFF, 0xFF, 0x00, 0x00, 0x00, 0x00, 0x00, 0x00, 0x00, 0x00,
  0x00, 0x00, 0x00, 0x00, 0x00, 0x00, 0x00, 0x03, 0xFF, 0xFF, 0xFF, 0xFF, 0x00, 0x00, 0x00, 0x00, 0x00, 0x00, 0x00, 0x00,
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  0x00, 0x00, 0x00, 0x00, 0x00, 0x00, 0x00, 0xFF, 0xFF, 0xFF, 0xFF, 0xFF, 0xF8, 0x00, 0x00, 0x00, 0x00, 0x00, 0x00, 0x00,
};

static const uint8_t kTop[3840] PROGMEM = {
  0x00, 0x00, 0x00, 0x00, 0x00, 0x00, 0x00, 0x03, 0xFF, 0xFF, 0xFF, 0xFF, 0x00, 0x00, 0x00, 0x00, 0x00, 0x00, 0x00, 0x00,
  0x00, 0x00, 0x00, 0x00, 0x00, 0x00, 0x00, 0x03, 0xFF, 0xFF, 0xFF, 0xFF, 0x00, 0x00, 0x00, 0x00, 0x00, 0x00, 0x00, 0x00,
  0x00, 0x00, 0x00, 0x00, 0x00, 0x00, 0x00, 0x03, 0xFF, 0xFF, 0xFF, 0xFF, 0x00, 0x00, 0x00, 0x00, 0x00, 0x00, 0x00, 0x00,
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  0x00, 0x00, 0x00, 0x00, 0x00, 0x00, 0x00, 0x00, 0x00, 0x00, 0x00, 0x00, 0x00, 0x00, 0x00, 0x00, 0x00, 0x00, 0x00, 0x00,
};

static const uint8_t kBot[3840] PROGMEM = {
  0x00, 0x00, 0x00, 0x00, 0x00, 0x00, 0x00, 0x00, 0x00, 0x00, 0x00, 0x00, 0x00, 0x00, 0x00, 0x00, 0x00, 0x00, 0x00, 0x00,
  0x00, 0x00, 0x00, 0x00, 0x00, 0x00, 0x00, 0x00, 0x00, 0x00, 0x00, 0x00, 0x00, 0x00, 0x00, 0x00, 0x00, 0x00, 0x00, 0x00,
  0x00, 0x00, 0x00, 0x00, 0x00, 0x00, 0x00, 0x00, 0x00, 0x00, 0x00, 0x00, 0x00, 0x00, 0x00, 0x00, 0x00, 0x00, 0x00, 0x00,
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  0x00, 0x00, 0x00, 0x00, 0x00, 0x00, 0x00, 0xFF, 0xFF, 0xFF, 0xFF, 0xFF, 0xF8, 0x00, 0x00, 0x00, 0x00, 0x00, 0x00, 0x00,
};

static const int16_t kCrackTop[kW] PROGMEM = {
  87, 87, 90, 90, 90, 71, 81, 81, 81, 81, 81, 78,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 87
};
static const int16_t kCrackBot[kW] PROGMEM = {
  93, 93, 96, 96, 96, 102, 102, 102, 107, 107, 107, 110,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 93
};

static void blit(TFT_eSprite& d, const uint8_t* bits, int ox, int oy, uint16_t color) {
  const int dx0 = kX + ox;
  const int dy0 = kY + oy;
  for (int y = 0; y < kH; ++y) {
    const int dy = dy0 + y;
    if ((unsigned)dy >= 240u) continue;
    const uint8_t* row = bits + y * kBy;
    int run = 0;
    int rx = 0;
    for (int x = 0; x < kW; ++x) {
      const uint8_t b = pgm_read_byte(row + (x >> 3));
      const bool on = b & (0x80 >> (x & 7));
      if (on) {
        if (!run) rx = x;
        run++;
      } else if (run) {
        d.fillRect(dx0 + rx, dy, run, 1, color);
        run = 0;
      }
    }
    if (run) d.fillRect(dx0 + rx, dy, run, 1, color);
  }
}

static void blitHalf(TFT_eSprite& d, const uint8_t* bits, const int16_t* lip, int ox, int oy, int inset, bool top, uint16_t color) {
  const int dx0 = kX + ox;
  const int dy0 = kY + oy;
  for (int y = 0; y < kH; ++y) {
    const uint8_t* row = bits + y * kBy;
    int run = 0;
    int rx = 0;
    int runY = 0;
    for (int x = 0; x <= kW; ++x) {
      bool on = false;
      int destY = -9999;
      if (x < kW) {
        const uint8_t b = pgm_read_byte(row + (x >> 3));
        on = b & (0x80 >> (x & 7));
        if (on) {
          const int edge = (int)pgm_read_word(&lip[x]);
          if (top) {
            if (y <= edge - inset) destY = dy0 + y;
          } else {
            if (y >= edge + inset) destY = dy0 + y;
          }
        }
      }
      if (on && destY != -9999) {
        if (!run) {
          rx = x;
          runY = destY;
          run = 1;
        } else if (destY == runY) {
          run++;
        } else {
          if ((unsigned)runY < 240u) d.fillRect(dx0 + rx, runY, run, 1, color);
          rx = x;
          runY = destY;
          run = 1;
        }
      } else if (run) {
        if ((unsigned)runY < 240u) d.fillRect(dx0 + rx, runY, run, 1, color);
        run = 0;
      }
    }
  }
}

void hatchBlitClosed(TFT_eSprite& d, int ox, int oy, uint16_t color) { blit(d, kClosed, ox, oy, color); }
void hatchBlitTop(TFT_eSprite& d, int ox, int oy, uint16_t color) { blit(d, kTop, ox, oy, color); }
void hatchBlitBottom(TFT_eSprite& d, int ox, int oy, uint16_t color) { blit(d, kBot, ox, oy, color); }

int hatchCrackTop(int x) {
  if ((unsigned)x >= (unsigned)kW) return kH / 2;
  return (int)pgm_read_word(&kCrackTop[x]);
}
int hatchCrackBot(int x) {
  if ((unsigned)x >= (unsigned)kW) return kH / 2;
  return (int)pgm_read_word(&kCrackBot[x]);
}
int hatchCrackMid(int x) {
  return (hatchCrackTop(x) + hatchCrackBot(x)) / 2;
}

void hatchBlitShell(TFT_eSprite& d, int ox, int oy, int split, int open, float crackLen, uint16_t color) {
  if (crackLen < 0) crackLen = 0;
  if (crackLen > 1) crackLen = 1;
  if (open < 0) open = 0;
  if (split > 0) {
    blitHalf(d, kTop, kCrackTop, ox, oy - split, 0, true, color);
    blitHalf(d, kBot, kCrackBot, ox, oy + split, 0, false, color);
    return;
  }
  if (crackLen < 0.02f) {
    hatchBlitClosed(d, ox, oy, color);
    return;
  }

  const int dx0 = kX + ox;
  const int dy0 = kY + oy;
  const int mid = kW / 2;
  const int span = (int)((kW * 0.5f) * crackLen);
  float widen = (float)open / 16.0f;
  if (widen > 1) widen = 1;

  for (int y = 0; y < kH; ++y) {
    const uint8_t* row = kClosed + y * kBy;
    int run = 0;
    int rx = 0;
    for (int x = 0; x <= kW; ++x) {
      bool on = false;
      if (x < kW) {
        const uint8_t b = pgm_read_byte(row + (x >> 3));
        on = b & (0x80 >> (x & 7));
        if (on && span > 0 && x >= mid - span && x <= mid + span) {
          const int ct = (int)pgm_read_word(&kCrackTop[x]);
          const int cb = (int)pgm_read_word(&kCrackBot[x]);
          const int zy = (ct + cb) / 2;
          int gapT = (int)lroundf((float)zy + (float)(ct - zy) * widen);
          int gapB = (int)lroundf((float)zy + (float)(cb - zy) * widen);
          if (gapB - gapT < 3) {
            gapT = zy - 1;
            gapB = zy + 1;
          }
          if (y > gapT && y < gapB) on = false;
        }
      }
      if (on) {
        if (!run) rx = x;
        run++;
      } else if (run) {
        const int dy = dy0 + y;
        if ((unsigned)dy < 240u) d.fillRect(dx0 + rx, dy, run, 1, color);
        run = 0;
      }
    }
  }
}

int hatchEggW() { return kW; }
int hatchEggH() { return kH; }
int hatchEggX() { return kX; }
int hatchEggY() { return kY; }
